
/*
* Copyright (c) 2021 Casey Webster
*
* SPDX-License-Identifier: MIT
*/

#include "tbkmini.dtsi"

&kscan0 {
	col-gpios
	= <&pro_micro 19 GPIO_ACTIVE_HIGH>// Col 1 - F6
	, <&pro_micro 20 GPIO_ACTIVE_HIGH>// Col 2 - F5
	, <&pro_micro 10 GPIO_ACTIVE_HIGH>// Col 3 - B6
	, <&pro_micro 6 GPIO_ACTIVE_HIGH>// Col 4 - D7
	, <&pro_micro 7 GPIO_ACTIVE_HIGH>// Col 5 - E6
	, <&pro_micro 8 GPIO_ACTIVE_HIGH>// Col 6 - B4
	;
};
